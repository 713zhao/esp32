## esp32c6/my_ui/main/Kconfig.projbuild
```kconfig
menu "App WiFi"
    config APP_WIFI_SSID
        string "WiFi SSID (2.4 GHz only)"
        default ""
    config APP_WIFI_PASSWORD
        string "WiFi password"
        default ""
    config APP_TIMEZONE
        string "POSIX TZ string for the clock"
        default "UTC0"
        help
            Examples: SGT-8 (Singapore), CST-8 (China), JST-9, PST8PDT,M3.2.0,M11.1.0,
            CET-1CEST,M3.5.0,M10.5.0/3. Note POSIX sign is inverted vs UTC offset.
endmenu

menu "App Chat"
    config APP_CHAT_NAME
        string "Device display name"
        default "ESP32 Chat"
    config APP_CHAT_HOSTNAME
        string "mDNS hostname (<name>.local)"
        default "esp32-chat"
    config APP_CHAT_TOKEN
        string "Shared token (empty = no auth on LAN)"
        default ""
        help
            If set, clients must send header X-Token: <token> (or ?token=<token>).
endmenu
```

## skills/esp32c6/templates/lcd19_chat_app/sdkconfig.defaults
```kconfig
CONFIG_IDF_TARGET="esp32c6"
CONFIG_ESPTOOLPY_FLASHSIZE_8MB=y
CONFIG_PARTITION_TABLE_CUSTOM=y
CONFIG_PARTITION_TABLE_CUSTOM_FILENAME="partitions.csv"
CONFIG_FREERTOS_HZ=1000
CONFIG_ESP_MAIN_TASK_STACK_SIZE=6144
CONFIG_ESP_SYSTEM_USE_FRAME_POINTER=y
CONFIG_BT_ENABLED=n

# LVGL 9
CONFIG_LV_USE_CLIB_MALLOC=y
CONFIG_LV_USE_CLIB_STRING=y
CONFIG_LV_USE_CLIB_SPRINTF=y
CONFIG_LV_DEF_REFR_PERIOD=16
CONFIG_LV_FONT_MONTSERRAT_14=y
CONFIG_LV_FONT_MONTSERRAT_20=y
CONFIG_LV_FONT_MONTSERRAT_28=y
CONFIG_LV_FONT_MONTSERRAT_40=y
CONFIG_LV_FONT_DEFAULT_MONTSERRAT_14=y
# Uncomment to show FPS/CPU overlay:
# CONFIG_LV_USE_SYSMON=y
# CONFIG_LV_USE_PERF_MONITOR=y
```

## skills/esp32c6/templates/lcd19_touch_app/main/Kconfig.projbuild
```kconfig
menu "App WiFi"
    config APP_WIFI_SSID
        string "WiFi SSID (2.4 GHz only)"
        default ""
    config APP_WIFI_PASSWORD
        string "WiFi password"
        default ""
    config APP_TIMEZONE
        string "POSIX TZ string for the clock"
        default "UTC0"
        help
            Examples: SGT-8 (Singapore), CST-8 (China), JST-9, PST8PDT,M3.2.0,M11.1.0,
            CET-1CEST,M3.5.0,M10.5.0/3. Note POSIX sign is inverted vs UTC offset.
endmenu
```
